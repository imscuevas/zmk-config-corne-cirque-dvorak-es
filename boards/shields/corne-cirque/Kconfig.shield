## boards/shields/corne-cirque/Kconfig.shield
```kconfig
# Copyright (c) 2020 Pete Johanson
# SPDX-License-Identifier: MIT

config SHIELD_CORNECIRQUE_LEFT
    def_bool $(shields_list_contains,cornecirque_left)

config SHIELD_CORNECIRQUE_RIGHT
    def_bool $(shields_list_contains,cornecirque_right)
```
